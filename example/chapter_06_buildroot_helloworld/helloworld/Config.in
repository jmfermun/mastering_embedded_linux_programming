## example/chapter_06_buildroot_helloworld/helloworld/Config.in
```kconfig
config BR2_PACKAGE_HELLOWORLD
    bool "helloworld"
    help
        A friendly program that prints Hello World! Every 10s
```

## yocto/build-nova/conf/bblayers.conf
```bitbake
# POKY_BBLAYERS_CONF_VERSION is increased each time build/conf/bblayers.conf
# changes incompatibly
POKY_BBLAYERS_CONF_VERSION = "2"

BBPATH = "${TOPDIR}"
BBFILES ?= ""

BBLAYERS ?= " \
  /home/jmfermun/development/repositories/mastering_embedded_linux_programming/yocto/poky/meta \
  /home/jmfermun/development/repositories/mastering_embedded_linux_programming/yocto/poky/meta-poky \
  /home/jmfermun/development/repositories/mastering_embedded_linux_programming/yocto/poky/meta-yocto-bsp \
  /home/jmfermun/development/repositories/mastering_embedded_linux_programming/yocto/meta-nova \
  "
```

## yocto/build-rpi/conf/bblayers.conf
```bitbake
# POKY_BBLAYERS_CONF_VERSION is increased each time build/conf/bblayers.conf
# changes incompatibly
POKY_BBLAYERS_CONF_VERSION = "2"

BBPATH = "${TOPDIR}"
BBFILES ?= ""

BBLAYERS ?= " \
  /home/jmfermun/development/repositories/mastering_embedded_linux_programming/yocto/poky/meta \
  /home/jmfermun/development/repositories/mastering_embedded_linux_programming/yocto/poky/meta-poky \
  /home/jmfermun/development/repositories/mastering_embedded_linux_programming/yocto/poky/meta-yocto-bsp \
  /home/jmfermun/development/repositories/mastering_embedded_linux_programming/yocto/meta-openembedded/meta-oe \
  /home/jmfermun/development/repositories/mastering_embedded_linux_programming/yocto/meta-openembedded/meta-python \
  /home/jmfermun/development/repositories/mastering_embedded_linux_programming/yocto/meta-openembedded/meta-networking \
  /home/jmfermun/development/repositories/mastering_embedded_linux_programming/yocto/meta-openembedded/meta-multimedia \
  /home/jmfermun/development/repositories/mastering_embedded_linux_programming/yocto/meta-raspberrypi \
  /home/jmfermun/development/repositories/mastering_embedded_linux_programming/yocto/meta-mackerel \
  "
```
